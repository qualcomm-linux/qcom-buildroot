## br-ext/Config.in
```kconfig
source "$BR2_EXTERNAL_OPTEE_PATH/package/optee_os_ext/Config.in"
source "$BR2_EXTERNAL_OPTEE_PATH/package/optee_client_ext/Config.in"
source "$BR2_EXTERNAL_OPTEE_PATH/package/optee_test_ext/Config.in"
source "$BR2_EXTERNAL_OPTEE_PATH/package/optee_examples_ext/Config.in"
source "$BR2_EXTERNAL_OPTEE_PATH/package/optee_rust_examples_ext/Config.in"
source "$BR2_EXTERNAL_OPTEE_PATH/package/ftpm_optee_ext/Config.in"
source "$BR2_EXTERNAL_OPTEE_PATH/package/linux_ftpm_mod_ext/Config.in"
source "$BR2_EXTERNAL_OPTEE_PATH/package/xen_ext/Config.in"
source "$BR2_EXTERNAL_OPTEE_PATH/package/fastrpc_ext/Config.in"
source "$BR2_EXTERNAL_OPTEE_PATH/package/qrtr_ext/Config.in"
source "$BR2_EXTERNAL_OPTEE_PATH/package/tqftpserv_ext/Config.in"
source "$BR2_EXTERNAL_OPTEE_PATH/package/rmtfs_ext/Config.in"
source "$BR2_EXTERNAL_OPTEE_PATH/package/kvm_unit_tests_ext/Config.in"
source "$BR2_EXTERNAL_OPTEE_PATH/package/kvm_guest_ext/Config.in"
source "$BR2_EXTERNAL_OPTEE_PATH/package/egl_readback_ext/Config.in"
source "$BR2_EXTERNAL_OPTEE_PATH/package/tflite_run_ext/Config.in"
source "$BR2_EXTERNAL_OPTEE_PATH/package/idregs_arm64_ext/Config.in"
```

## br-ext/package/egl_readback_ext/Config.in
```kconfig
config BR2_PACKAGE_EGL_READBACK_EXT
	bool "egl-readback"
	depends on BR2_PACKAGE_HAS_LIBEGL
	depends on BR2_PACKAGE_HAS_LIBGLES
	depends on BR2_PACKAGE_HAS_LIBGBM
	select BR2_PACKAGE_LIBDRM
	help
	  Headless GPU check: on the msm render node, renders through
	  GBM, EGL and OpenGL ES 2 into an offscreen framebuffer, reads
	  it back and checks the pixels, then times 500 frames. It exits
	  0 only if the GPU drew the expected pixels.
```

## br-ext/package/idregs_arm64_ext/Config.in
```kconfig
config BR2_PACKAGE_IDREGS_ARM64_EXT
	bool "idregs-arm64"
	depends on BR2_aarch64
	help
	  idregs-arm64 from test-definitions (cpu-features): reads the
	  AArch64 ID registers from EL0 on every CPU, the KVM view of a
	  vCPU, and exercises pointer authentication, SVE and SME. A
	  static binary built against nolibc, so it needs no C library.

	  https://github.com/Linaro/test-definitions
```

## br-ext/package/kvm_guest_ext/Config.in
```kconfig
config BR2_PACKAGE_KVM_GUEST_EXT
	bool "kvm-guest"
	depends on BR2_aarch64
	depends on BR2_PACKAGE_BUSYBOX
	help
	  A small Linux guest for KVM tests, in /opt/kvm-guest: a
	  kernel built for a kvmtool or QEMU virtual machine (virtio
	  console over PCI or MMIO, PSCI) and an initramfs with
	  BusyBox. The guest's init prints a ready line with its CPU
	  count, kernel release and uptime, then runs a shell on the
	  console.
```

## br-ext/package/kvm_unit_tests_ext/Config.in
```kconfig
config BR2_PACKAGE_KVM_UNIT_TESTS_EXT
	bool "kvm-unit-tests"
	depends on BR2_aarch64
	depends on BR2_USE_MMU # bash, kvmtool
	depends on BR2_PACKAGE_BUSYBOX_SHOW_OTHERS # bash
	depends on BR2_TOOLCHAIN_USES_GLIBC || BR2_TOOLCHAIN_USES_MUSL # kvmtool
	depends on !BR2_STATIC_LIBS # kvmtool
	select BR2_PACKAGE_BASH
	select BR2_PACKAGE_KVMTOOL
	help
	  The KVM unit tests (tiny guests that check one KVM or
	  virtual hardware feature each) built for kvmtool, with their
	  runner, in /opt/kvm-unit-tests: run_tests.sh runs them
	  against /dev/kvm. The runner and the run scripts are bash.

	  https://gitlab.com/kvm-unit-tests/kvm-unit-tests
```

## br-ext/package/rmtfs_ext/Config.in
```kconfig
config BR2_PACKAGE_RMTFS_EXT
	bool "rmtfs"
	depends on BR2_PACKAGE_HAS_UDEV
	select BR2_PACKAGE_QRTR_EXT
	help
	  Qualcomm Remote Filesystem service (rmtfs). Serves the DSP /
	  peripheral persistent (EFS) storage over QRTR. Needed for the
	  ADSP protection domains to come up; without it ADSP FastRPC
	  stalls on a GLINK intent timeout even though the remoteproc
	  authenticates and boots.

	  Requires a udev provider (eudev) for libudev and for the
	  /dev/disk/by-partlabel/rmtfs symlink used by "rmtfs -P".

	  https://github.com/linux-msm/rmtfs
```

## br-ext/package/tflite_run_ext/Config.in
```kconfig
config BR2_PACKAGE_TFLITE_RUN_EXT
	bool "tflite-run"
	depends on BR2_PACKAGE_TENSORFLOW_LITE
	help
	  Runs a TensorFlow Lite model on a list of raw input files,
	  with the XNNPACK delegate on the CPU or the GPU delegate,
	  and writes each output and the time of each inference, in
	  the layout qnn-net-run uses (test-definitions
	  automated/linux/inference).
```

## br-ext/package/xen_guest_ext/Config.in
```kconfig
config BR2_PACKAGE_XEN_GUEST_EXT
	bool "xen-guest"
	depends on BR2_aarch64
	depends on BR2_PACKAGE_BUSYBOX
	help
	  A small Linux guest for the Xen tests, in /opt/xen-guest: a
	  kernel built for a Xen PV-console guest (Xen guest support,
	  hvc0, the FF-A transport and the OP-TEE driver, so a guest
	  given a TEE by its toolstack can reach it) and an initramfs
	  with BusyBox. The guest's init prints a ready line and a TEE
	  line on hvc0, stays up, and prints a poweroff line when the
	  toolstack asks it to shut down (the console protocol of the
	  test-definitions automated/linux/xen README).
```
